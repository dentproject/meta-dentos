## conf/distro/dentos.conf
```bitbake
# For the moment we can inherit Poky to keep things sane.
require conf/distro/poky.conf

DISTRO = "dentos"
DISTRO_NAME = "dentOS"
DISTRO_VERSION = "3.2"

DISTRO_CODENAME = "Cynthia"
DISTROOVERRIDES = "poky:dentos"

DISTRO_FEATURES_DEFAULT ?= "acl argp ext2 ipv4 ipv6 largefile pci systemd usrmerge usbhost vfat xattr"
DISTRO_FEATURES_BACKFILL_CONSIDERED = "sysvinit pulseaudio"
DISTRO_FEATURES:remove = "alsa opengl wayland vulkan"

VIRTUAL-RUNTIME_init_manager = "systemd"
VIRTUAL-RUNTIME_initscripts = ""
VIRTUAL-RUNTIME_login_manager = "systemd"

PREFERRED_PROVIDER_udev ?= "systemd"
PREFERRED_PROVIDER_udev-utils ?= "systemd"
```

## conf/layer.conf
```bitbake
# We have a conf and classes directory, add to BBPATH
BBPATH .= ":${LAYERDIR}"

# We have recipes-* directories, add to BBFILES
BBFILES += "${LAYERDIR}/recipes-*/*/*.bb \
            ${LAYERDIR}/recipes-*/*/*.bbappend"

BBFILE_COLLECTIONS += "dentos"
BBFILE_PATTERN_dentos = "^${LAYERDIR}/"
BBFILE_PRIORITY_dentos = "6"

LAYERDEPENDS_dentos = "core switchbsp meta-python"
LAYERSERIES_COMPAT_dentos = "styhead walnascar"
```
